## conf/layer.conf
```bitbake
# We have a conf and classes directory, add to BBPATH
BBPATH .= ":${LAYERDIR}"

# We have recipes-* directories, add to BBFILES
BBFILES += "${LAYERDIR}/recipes-*/*/*.bb \
	${LAYERDIR}/recipes-*/*/*.bbappend"

BBFILE_COLLECTIONS += "meta-dotnet"
BBFILE_PATTERN_meta-dotnet = "^${LAYERDIR}/"
BBFILE_PRIORITY_meta-dotnet= "6"

LAYERDEPENDS_meta-dotnet = "core"
LAYERSERIES_COMPAT_meta-dotnet = "scarthgap"
```
